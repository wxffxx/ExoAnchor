## device/ESP32P4/firmware/main/Kconfig.projbuild
```kconfig
menu "SI ESP32-P4 Host Configuration"

    config SI_ETH_ENABLE
        bool "Enable RJ45 Ethernet"
        default y
        select ETH_USE_ESP32_EMAC
        help
            Use the Waveshare ESP32-P4-NANO onboard 100M RJ45 Ethernet.
            The board schematic uses an IP101GRI PHY connected to ESP32-P4 EMAC.

    config SI_ETH_MDC_GPIO
        int "Ethernet SMI MDC GPIO"
        default 31
        depends on SI_ETH_ENABLE

    config SI_ETH_MDIO_GPIO
        int "Ethernet SMI MDIO GPIO"
        default 52
        depends on SI_ETH_ENABLE

    config SI_ETH_PHY_RST_GPIO
        int "Ethernet PHY reset GPIO"
        default 51
        depends on SI_ETH_ENABLE

    config SI_ETH_PHY_ADDR
        int "Ethernet PHY address"
        default 1
        range -1 31
        depends on SI_ETH_ENABLE

    config SI_ETH_WAIT_IP_TIMEOUT_MS
        int "Ethernet DHCP wait timeout"
        default 15000
        range 0 120000
        depends on SI_ETH_ENABLE

    config SI_AUTH_USERNAME
        string "Default web/API username"
        default "admin"
        help
            Default local username used before the first account change.

    config SI_AUTH_PASSWORD
        string "Default web/API password"
        default "admin"
        help
            Empty string disables write API auth. Change the default credential on first login.

    menu "USB HID device"

        config SI_HID_USB_ENABLE
            bool "Enable USB HID on GPIO26/GPIO27"
            default y
            help
                Expose keyboard and mouse as a TinyUSB device through the
                ESP32-P4 Full-Speed USB controller. The internal FS PHY is
                wired to GPIO26 as DM and GPIO27 as DP, leaving the HS USB host
                controller available for the UVC camera.

        config SI_HID_USB_DM_GPIO
            int "USB HID DM GPIO"
            default 26
            range 0 54
            depends on SI_HID_USB_ENABLE

        config SI_HID_USB_DP_GPIO
            int "USB HID DP GPIO"
            default 27
            range 0 54
            depends on SI_HID_USB_ENABLE

    endmenu

    menu "USB UVC video input"

        config SI_VIDEO_ENABLE
            bool "Enable USB UVC video input"
            default y
            help
                Enable the USB camera path for the web UI. On ESP32-P4 the
                High-Speed USB controller is used for the UVC camera, while the
                Full-Speed USB controller can still expose HID on GPIO26/27.

        config SI_VIDEO_WIDTH
            int "USB UVC MJPEG width"
            default 1280
            range 160 3840
            depends on SI_VIDEO_ENABLE

        config SI_VIDEO_HEIGHT
            int "USB UVC MJPEG height"
            default 720
            range 120 2160
            depends on SI_VIDEO_ENABLE

        config SI_VIDEO_UVC_FPS
            int "USB UVC MJPEG FPS"
            default 30
            range 1 60
            depends on SI_VIDEO_ENABLE

        config SI_VIDEO_UVC_FRAME_BUFFERS
            int "USB UVC frame buffers"
            default 3 if SPIRAM
            default 2
            range 2 6
            depends on SI_VIDEO_ENABLE

        config SI_VIDEO_UVC_URBS
            int "USB UVC URB count"
            default 4
            range 2 8
            depends on SI_VIDEO_ENABLE

        config SI_VIDEO_UVC_URB_SIZE
            int "USB UVC URB size"
            default 16384
            range 4096 65536
            depends on SI_VIDEO_ENABLE

        config SI_VIDEO_UVC_JPEG_BUFFER_SIZE
            int "USB UVC latest JPEG buffer size"
            default 1048576
            range 65536 2097152
            depends on SI_VIDEO_ENABLE
            help
                Largest MJPEG frame copied out of the UVC driver for HTTP
                snapshot and MJPEG streaming.

        config SI_VIDEO_JPEG_QUALITY
            int "Reported MJPEG/JPEG quality"
            default 75
            range 1 100
            depends on SI_VIDEO_ENABLE
            help
                UVC cameras usually produce MJPEG internally. This value is
                retained for the web API and future cameras that expose quality
                controls.

        config SI_VIDEO_STREAM_DELAY_MS
            int "MJPEG frame delay"
            default 33
            range 10 1000
            depends on SI_VIDEO_ENABLE

    endmenu

endmenu
```

## device/ESP32P4/firmware/sdkconfig.defaults
```kconfig
CONFIG_IDF_TARGET="esp32p4"
CONFIG_ESP32P4_SELECTS_REV_LESS_V3=y
CONFIG_ESP32P4_REV_MIN_1=y
CONFIG_ESPTOOLPY_FLASHMODE_QIO=y
CONFIG_ESPTOOLPY_FLASHSIZE_16MB=y
CONFIG_PARTITION_TABLE_CUSTOM=y
CONFIG_PARTITION_TABLE_CUSTOM_FILENAME="partitions.csv"
CONFIG_PARTITION_TABLE_FILENAME="partitions.csv"
CONFIG_COMPILER_OPTIMIZATION_PERF=y
CONFIG_SPIRAM=y
CONFIG_SPIRAM_SPEED_200M=y
CONFIG_SPIRAM_XIP_FROM_PSRAM=y
CONFIG_CACHE_L2_CACHE_256KB=y
CONFIG_CACHE_L2_CACHE_LINE_128B=y
CONFIG_ESP_MAIN_TASK_STACK_SIZE=10240
CONFIG_FREERTOS_HZ=1000
CONFIG_FREERTOS_VTASKLIST_INCLUDE_COREID=y
CONFIG_FREERTOS_GENERATE_RUN_TIME_STATS=y
CONFIG_ETH_ENABLED=y
CONFIG_HTTPD_WS_SUPPORT=y
CONFIG_ESP_HTTP_CLIENT_ENABLE_HTTPS=y
CONFIG_MBEDTLS_CERTIFICATE_BUNDLE=y
CONFIG_MBEDTLS_CERTIFICATE_BUNDLE_DEFAULT_FULL=y
CONFIG_ETH_USE_ESP32_EMAC=y
CONFIG_LWIP_MAX_SOCKETS=16
CONFIG_ETH_PHY_INTERFACE_RMII=y
CONFIG_ETH_RMII_CLK_INPUT=y
CONFIG_SI_ETH_ENABLE=y
CONFIG_SI_ETH_MDC_GPIO=31
CONFIG_SI_ETH_MDIO_GPIO=52
CONFIG_SI_ETH_PHY_RST_GPIO=51
CONFIG_SI_ETH_PHY_ADDR=1
CONFIG_SI_ETH_WAIT_IP_TIMEOUT_MS=15000
CONFIG_SI_AUTH_PASSWORD="admin"
CONFIG_SI_HID_USB_ENABLE=y
CONFIG_SI_HID_USB_DM_GPIO=26
CONFIG_SI_HID_USB_DP_GPIO=27
CONFIG_SI_VIDEO_ENABLE=y
CONFIG_SI_VIDEO_WIDTH=1280
CONFIG_SI_VIDEO_HEIGHT=720
CONFIG_SI_VIDEO_UVC_FPS=30
CONFIG_SI_VIDEO_UVC_FRAME_BUFFERS=3
CONFIG_SI_VIDEO_UVC_URBS=4
CONFIG_SI_VIDEO_UVC_URB_SIZE=16384
CONFIG_SI_VIDEO_UVC_JPEG_BUFFER_SIZE=1048576
CONFIG_SI_VIDEO_JPEG_QUALITY=75
CONFIG_SI_VIDEO_STREAM_DELAY_MS=33
CONFIG_USB_HOST_CONTROL_TRANSFER_MAX_SIZE=4096
CONFIG_USB_HOST_DEBOUNCE_DELAY_MS=500
CONFIG_USB_HOST_RESET_HOLD_MS=100
CONFIG_USB_HOST_RESET_RECOVERY_MS=100
CONFIG_USB_HOST_SET_ADDR_RECOVERY_MS=100
CONFIG_USB_HOST_EXT_PORT_RESET_RECOVERY_DELAY_MS=100
CONFIG_USB_HOST_HW_BUFFER_BIAS_IN=y
CONFIG_USB_HOST_HUBS_SUPPORTED=y
CONFIG_TINYUSB_HID_COUNT=3
CONFIG_TINYUSB_MIDI_COUNT=0
CONFIG_TINYUSB_DFU_MODE_NONE=y
CONFIG_TINYUSB_NET_MODE_NONE=y
CONFIG_TINYUSB_VENDOR_COUNT=0
```

## device/ESP32P4/firmware/v0.86-stable-kvm/configs/boards/sdkconfig.defaults.exoanchor-prototype-v2.1
```kconfig
# Netlist_SCH_ESP32P4_Prototype_V2.1b_2026-07-14.net
# Compile-only design reference; no hardware-verification claim.
CONFIG_SI_BOARD_EXOANCHOR_PROTOTYPE_V21=y
CONFIG_SI_POWER_BUTTON_GPIO=5
CONFIG_SI_RESET_BUTTON_GPIO=4
CONFIG_SI_POWER_ACTIVE_HIGH=y
CONFIG_SI_POWER_DETECT_GPIO=0
CONFIG_SI_POWER_DETECT_ACTIVE_HIGH=y
CONFIG_SI_STANDBY_DETECT_GPIO=1
CONFIG_SI_STANDBY_DETECT_ACTIVE_HIGH=y
CONFIG_SI_POWER_RESERVE1_GPIO=-1
CONFIG_SI_POWER_LOCATOR_GPIO=15
CONFIG_SI_POWER_LOCATOR_ACTIVE_HIGH=y
```

## device/ESP32P4/firmware/v0.86-stable-kvm/configs/boards/sdkconfig.defaults.exoanchor-prototype-v2.3
```kconfig
# Netlist_SCH_ESP32P4_Prototype_V2.3b6_2026-07-14.net
# Draft only: not fabricated, not finalized, and not hardware-verified.
CONFIG_SI_BOARD_EXOANCHOR_PROTOTYPE_V23=y
CONFIG_SI_POWER_BUTTON_GPIO=4
CONFIG_SI_RESET_BUTTON_GPIO=5
CONFIG_SI_POWER_ACTIVE_HIGH=y
CONFIG_SI_POWER_DETECT_GPIO=0
CONFIG_SI_POWER_DETECT_ACTIVE_HIGH=y
CONFIG_SI_STANDBY_DETECT_GPIO=1
CONFIG_SI_STANDBY_DETECT_ACTIVE_HIGH=y
CONFIG_SI_POWER_RESERVE1_GPIO=-1
CONFIG_SI_POWER_LOCATOR_GPIO=17
CONFIG_SI_POWER_LOCATOR_ACTIVE_HIGH=y
```
