## hosts/esphost-esp32p4/firmware/main/Kconfig.projbuild
```kconfig
menu "SI ESP32-P4 Host Configuration"

    config SI_ETH_ENABLE
        bool "Enable RJ45 Ethernet"
        default y
        select ETH_USE_ESP32_EMAC
        help
            Use the Waveshare ESP32-P4-NANO onboard 100M RJ45 Ethernet.
            The board schematic uses an IP101GR PHY connected to ESP32-P4 EMAC.

    config SI_ETH_MDC_GPIO
        int "Ethernet SMI MDC GPIO"
        default 31
        depends on SI_ETH_ENABLE

    config SI_ETH_MDIO_GPIO
        int "Ethernet SMI MDIO GPIO"
        default 52
        depends on SI_ETH_ENABLE

    config SI_ETH_PHY_RST_GPIO
        int "Ethernet PHY reset GPIO"
        default 51
        depends on SI_ETH_ENABLE

    config SI_ETH_PHY_ADDR
        int "Ethernet PHY address"
        default 1
        range -1 31
        depends on SI_ETH_ENABLE

    config SI_ETH_WAIT_IP_TIMEOUT_MS
        int "Ethernet DHCP wait timeout"
        default 15000
        range 0 120000
        depends on SI_ETH_ENABLE

    config SI_AUTH_PASSWORD
        string "Web/API bearer password"
        default "admin"
        help
            Empty string disables write API auth. The dashboard stores this as a bearer token.

    menu "Video input"

        config SI_VIDEO_ENABLE
            bool "Enable MIPI-CSI video input"
            default y
            help
                Use the ESP32-P4 MIPI-CSI controller as the video input path.

        config SI_VIDEO_CAMERA_SENSOR
            bool "Initialize a MIPI camera sensor over SCCB/I2C"
            default y
            depends on SI_VIDEO_ENABLE
            help
                Enable this for OV5647/SC2336-style camera modules connected to
                the Waveshare ESP32-P4-NANO CSI connector. Disable it when the
                source is an externally configured HDMI-to-CSI bridge emitting
                YUV422.

        config SI_VIDEO_WIDTH
            int "CSI input width"
            default 800 if SI_VIDEO_CAMERA_SENSOR
            default 1280
            depends on SI_VIDEO_ENABLE

        config SI_VIDEO_HEIGHT
            int "CSI input height"
            default 640 if SI_VIDEO_CAMERA_SENSOR
            default 720
            depends on SI_VIDEO_ENABLE

        config SI_VIDEO_DATA_LANES
            int "CSI data lanes"
            default 2
            range 1 2
            depends on SI_VIDEO_ENABLE

        config SI_VIDEO_LANE_BITRATE_MBPS
            int "CSI lane bitrate in Mbps"
            default 200 if SI_VIDEO_CAMERA_SENSOR
            default 800
            range 80 1500
            depends on SI_VIDEO_ENABLE
            help
                OV5647/SC2336 camera sensor formats in the ESP camera sensor
                driver commonly use 200 Mbps for 800x640 RAW8.
                720p60 or 1080p30 YUV422 2-lane usually starts around
                650-800 Mbps with margin. 1080p60 typically needs roughly
                1200-1350 Mbps.

        config SI_VIDEO_SENSOR_FORMAT
            string "MIPI camera sensor format name"
            default "MIPI_2lane_24Minput_RAW8_800x640_50fps"
            depends on SI_VIDEO_ENABLE && SI_VIDEO_CAMERA_SENSOR
            help
                Must match one of the format names printed by the detected
                sensor driver.

        config SI_VIDEO_SCCB_SCL_GPIO
            int "Camera SCCB/I2C SCL GPIO"
            default 8
            depends on SI_VIDEO_ENABLE && SI_VIDEO_CAMERA_SENSOR

        config SI_VIDEO_SCCB_SDA_GPIO
            int "Camera SCCB/I2C SDA GPIO"
            default 7
            depends on SI_VIDEO_ENABLE && SI_VIDEO_CAMERA_SENSOR

        config SI_VIDEO_SCCB_FREQ_HZ
            int "Camera SCCB/I2C clock"
            default 10000
            range 1000 400000
            depends on SI_VIDEO_ENABLE && SI_VIDEO_CAMERA_SENSOR

        config SI_VIDEO_SENSOR_RESET_GPIO
            int "Camera sensor reset GPIO (-1 for none)"
            default -1
            depends on SI_VIDEO_ENABLE && SI_VIDEO_CAMERA_SENSOR

        config SI_VIDEO_SENSOR_PWDN_GPIO
            int "Camera sensor power-down GPIO (-1 for none)"
            default -1
            depends on SI_VIDEO_ENABLE && SI_VIDEO_CAMERA_SENSOR

        config SI_VIDEO_BYTE_SWAP
            bool "Enable CSI byte swap"
            default n
            depends on SI_VIDEO_ENABLE && !SI_VIDEO_CAMERA_SENSOR
            help
                Toggle this when LT6911C YUV422 byte order is wrong.

        config SI_VIDEO_JPEG_QUALITY
            int "MJPEG/JPEG quality"
            default 75
            range 1 100
            depends on SI_VIDEO_ENABLE

        config SI_VIDEO_STREAM_DELAY_MS
            int "MJPEG frame delay"
            default 120
            range 20 1000
            depends on SI_VIDEO_ENABLE

        config SI_VIDEO_MIPI_LDO_ENABLE
            bool "Enable internal LDO for MIPI PHY"
            default y
            depends on SI_VIDEO_ENABLE

        config SI_VIDEO_MIPI_LDO_CHAN_ID
            int "MIPI PHY LDO channel ID"
            default 3
            depends on SI_VIDEO_ENABLE && SI_VIDEO_MIPI_LDO_ENABLE

        config SI_VIDEO_MIPI_LDO_VOLTAGE_MV
            int "MIPI PHY LDO voltage"
            default 2500
            range 0 3300
            depends on SI_VIDEO_ENABLE && SI_VIDEO_MIPI_LDO_ENABLE

    endmenu

endmenu
```

## hosts/esphost-esp32p4/firmware/sdkconfig.defaults
```kconfig
CONFIG_IDF_TARGET="esp32p4"
CONFIG_ESP32P4_SELECTS_REV_LESS_V3=y
CONFIG_ESP32P4_REV_MIN_1=y
CONFIG_ESPTOOLPY_FLASHMODE_QIO=y
CONFIG_ESPTOOLPY_FLASHSIZE_16MB=y
CONFIG_COMPILER_OPTIMIZATION_PERF=y
CONFIG_SPIRAM=y
CONFIG_SPIRAM_SPEED_200M=y
CONFIG_SPIRAM_XIP_FROM_PSRAM=y
CONFIG_CACHE_L2_CACHE_256KB=y
CONFIG_CACHE_L2_CACHE_LINE_128B=y
CONFIG_ESP_MAIN_TASK_STACK_SIZE=10240
CONFIG_FREERTOS_HZ=1000
CONFIG_FREERTOS_VTASKLIST_INCLUDE_COREID=y
CONFIG_FREERTOS_GENERATE_RUN_TIME_STATS=y
CONFIG_HTTPD_WS_SUPPORT=y
CONFIG_TINYUSB_HID_COUNT=2
CONFIG_CAMERA_SC2336=y
CONFIG_CAMERA_OV5647=y
CONFIG_CAMERA_OV5647_MIPI_RAW8_800X640_50FPS=y
CONFIG_ETH_ENABLED=y
CONFIG_ETH_USE_ESP32_EMAC=y
CONFIG_ETH_PHY_INTERFACE_RMII=y
CONFIG_ETH_RMII_CLK_INPUT=y
CONFIG_SI_ETH_ENABLE=y
CONFIG_SI_ETH_MDC_GPIO=31
CONFIG_SI_ETH_MDIO_GPIO=52
CONFIG_SI_ETH_PHY_RST_GPIO=51
CONFIG_SI_ETH_PHY_ADDR=1
CONFIG_SI_ETH_WAIT_IP_TIMEOUT_MS=15000
CONFIG_SI_AUTH_PASSWORD="admin"
CONFIG_SI_VIDEO_ENABLE=y
CONFIG_SI_VIDEO_CAMERA_SENSOR=y
CONFIG_SI_VIDEO_WIDTH=800
CONFIG_SI_VIDEO_HEIGHT=640
CONFIG_SI_VIDEO_DATA_LANES=2
CONFIG_SI_VIDEO_LANE_BITRATE_MBPS=200
CONFIG_SI_VIDEO_SENSOR_FORMAT="MIPI_2lane_24Minput_RAW8_800x640_50fps"
CONFIG_SI_VIDEO_SCCB_SCL_GPIO=8
CONFIG_SI_VIDEO_SCCB_SDA_GPIO=7
CONFIG_SI_VIDEO_SCCB_FREQ_HZ=10000
CONFIG_SI_VIDEO_SENSOR_RESET_GPIO=-1
CONFIG_SI_VIDEO_SENSOR_PWDN_GPIO=-1
CONFIG_SI_VIDEO_JPEG_QUALITY=75
CONFIG_SI_VIDEO_STREAM_DELAY_MS=120
CONFIG_SI_VIDEO_MIPI_LDO_ENABLE=y
CONFIG_SI_VIDEO_MIPI_LDO_CHAN_ID=3
CONFIG_SI_VIDEO_MIPI_LDO_VOLTAGE_MV=2500
```
